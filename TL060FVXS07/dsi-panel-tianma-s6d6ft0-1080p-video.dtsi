	&mdss_mdp {
			dsi_s6d6ft0_tianma_fhd_video: qcom,mdss_dsi_s6d6ft0_tianma_fhd_video {
				qcom,mdss-dsi-panel-name = "s6d6ff0 tianma fhd video mode dsi panel";
				qcom,mdss-dsi-panel-type = "dsi_video_mode";
				qcom,mdss-dsi-panel-controller = <&mdss_dsi0>;
				qcom,mdss-dsi-panel-framerate = <0x3c>;
				qcom,mdss-dsi-virtual-channel-id = <0x0>;
				qcom,mdss-dsi-stream = <0x0>;
				qcom,mdss-dsi-panel-width = <0x438>;
				qcom,mdss-dsi-panel-height = <0x870>;
				qcom,mdss-dsi-h-front-porch = <0xe5>;
				qcom,mdss-dsi-h-back-porch = <0x4>;
				qcom,mdss-dsi-h-pulse-width = <0x4>;
				qcom,mdss-dsi-h-sync-skew = <0x0>;
				qcom,mdss-dsi-v-back-porch = <0x6>;
				qcom,mdss-dsi-v-front-porch = <0x8>;
				qcom,mdss-dsi-v-pulse-width = <0x2>;
				qcom,mdss-dsi-h-left-border = <0x0>;
				qcom,mdss-dsi-h-right-border = <0x0>;
				qcom,mdss-dsi-v-top-border = <0x0>;
				qcom,mdss-dsi-v-bottom-border = <0x0>;
				qcom,mdss-dsi-bpp = <0x18>;
				qcom,mdss-dsi-underflow-color = <0xff>;
				qcom,mdss-dsi-border-color = <0x0>;
				qcom,mdss-dsi-h-sync-pulse = <0x0>;
				qcom,mdss-dsi-traffic-mode = "burst_mode";
				qcom,mdss-dsi-bllp-eof-power-mode;
				qcom,mdss-dsi-bllp-power-mode;
				qcom,mdss-dsi-force-clock-lane-hs;
				qcom,mdss-dsi-lane-0-state;
				qcom,mdss-dsi-lane-1-state;
				qcom,mdss-dsi-lane-2-state;
				qcom,mdss-dsi-lane-3-state;
				qcom,mdss-dsi-panel-timings = <0x251f090a 0x6252009 0xa060304>;
				qcom,mdss-dsi-t-clk-post = <0xe>;
				qcom,mdss-dsi-t-clk-pre = <0x36>;
				/*qcom,mdss-dsi-bl-min-level = <0x1>;*/
				/*qcom,mdss-dsi-bl-max-level = <0xfff>;*/
				qcom,mdss-dsi-dma-trigger = "trigger_sw";
				qcom,mdss-dsi-mdp-trigger = "none";
				qcom,ulps-enabled;
				qcom,suspend-ulps-enabled;
				qcom,esd-check-enabled;
				qcom,mdss-dsi-panel-status-check-mode = "reg_read";
				qcom,mdss-dsi-panel-status-command = <0x6010001 0x10a>;
				qcom,mdss-dsi-panel-status-command-state = "dsi_hs_mode";
				qcom,mdss-dsi-panel-status-value = <0x9c>;
				qcom,mdss-dsi-panel-status-read-length = <0x1>;
				qcom,mdss-dsi-panel-max-error-count = <0x3>;
				qcom,mdss-dsi-on-command = <0x39010000 0x39f 0xa5a50501 0x7800 0x2110005 0x1000000 0x25510 0x39010000 0x3f0 0x5a5a3901 0x0 0x2739439 0x1000000 0x3dea00 0x73111b23 0x2a405970 0x6ea18692 0x9fabb84d 0x59657f00 0x73111b23 0x2a405970 0x6ea18692 0x9fabb84d 0x59657f00 0x73111b23 0x2a405970 0x6ea18692 0x9fabb84d 0x59657f39 0x1000000 0x3deb00 0x73111b23 0x2a405970 0x6ea18692 0x9fabb84d 0x59657f00 0x73111b23 0x2a405970 0x6ea18692 0x9fabb84d 0x59657f00 0x73111b23 0x2a405970 0x6ea18692 0x9fabb84d 0x59657f39 0x1000000 0x3f0a5 0xa5050100 0x2 0x29003901 0x0 0x39f5a5a>;
				qcom,mdss-dsi-off-command = <0x39010000 0x39f 0xa5a50501 0x0 0x2280005 0x1000050 0x21000 0x39010000 0x3f0 0x5a5a3901 0x0 0x2739039 0x1000000 0x3f0a5 0xa5050100 0x2 0x24003901 0x0 0x39f5a5a>;
				qcom,mdss-dsi-on-command-state = "dsi_hs_mode";
				qcom,mdss-dsi-off-command-state = "dsi_hs_mode";
				/*qcom,mdss-dsi-bl-pmic-control-type = "bl_ctrl_wled";*/
				qcom,mdss-dsi-reset-sequence = <0x1 0xa 0x0 0xa 0x1 0x28>;
				qcom,mdss-dsi-tx-eot-append;
				qcom,mdss-dsi-post-init-delay = <0x1>;
				qcom,mdss-dsi-panel-timings-phy-v2 = <0x2621090b 0x60304a0 0x2621090b 0x60304a0 0x2621090b 0x60304a0 0x2621090b 0x60304a0 0x2620090a 0x60304a0>;
		};
};

